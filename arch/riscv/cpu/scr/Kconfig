## arch/riscv/cpu/scr/Kconfig
```kconfig
# SPDX-License-Identifier: GPL-2.0+

#
# Copyright (C) 2022, Syntacore Ltd.
#
# This program is free software; you can redistribute it and/or
# modify it under the terms of the GNU General Public License
# as published by the Free Software Foundation; either version 2
# of the License, or (at your option) any later version.
#
# This program is distributed in the hope that it will be useful,
# but WITHOUT ANY WARRANTY; without even the implied warranty of
# MERCHANTABILITY or FITNESS FOR A PARTICULAR PURPOSE.  See the
# GNU General Public License for more details.
#
# You should have received a copy of the GNU General Public License
# along with this program; if not, write to the Free Software
# Foundation, Inc., 51 Franklin Street, Fifth Floor, Boston, MA 02110-1301, USA.
# Also add information on how to contact you by electronic and paper mail.

config SYNTACORE_SCR
	bool
	select SYS_CACHE_SHIFT_6
	select ARCH_EARLY_INIT_R
	imply CPU
	imply CPU_RISCV
	imply ARCH_RV64I
	imply RISCV_TIMER if (RISCV_SMODE || SPL_RISCV_SMODE)
	imply CMD_CPU

config SCR_CMO_BLOCK_SIZE
	int "Cache management operations granularity"
	default 32
	help
	   Minimal count of bytes affected by cache line flush/invalidation
	   operations. For SCR platforms it's basically the size of the
	   top-level cache line. It is safe however sub-optimal to
	   specify bytes count lesser than top-level cache line size.
	   In any case the value configured should be a power of 2.
```

## board/syntacore/scr_l2_cluster/Kconfig
```kconfig
#
# Copyright (C) 2024, Syntacore Ltd.
#
# This program is free software; you can redistribute it and/or
# modify it under the terms of the GNU General Public License
# as published by the Free Software Foundation; either version 2
# of the License, or (at your option) any later version.
#
# This program is distributed in the hope that it will be useful,
# but WITHOUT ANY WARRANTY; without even the implied warranty of
# MERCHANTABILITY or FITNESS FOR A PARTICULAR PURPOSE.  See the
# GNU General Public License for more details.
#
# You should have received a copy of the GNU General Public License
# along with this program; if not, write to the Free Software
# Foundation, Inc., 51 Franklin Street, Fifth Floor, Boston, MA 02110-1301, USA.
# Also add information on how to contact you by electronic and paper mail.

if TARGET_SCR_L2_CLUSTER

config SYS_BOARD
	default "scr_l2_cluster"

config SYS_VENDOR
	default "syntacore"

config SYS_CPU
	default "scr"

config SYS_CONFIG_NAME
	default "scr_l2_cluster"

config DEFAULT_DEVICE_TREE
	default "empty"

config TEXT_BASE
	default 0x00000000

config BOARD_SPECIFIC_OPTIONS
	def_bool y
	select SYNTACORE_SCR
	imply OF_HAS_PRIOR_STAGE
	imply SYS_NS16550
	imply SYS_NS16550_SERIAL
	imply XILINX_AXIEMAC
	imply PHY_TI_DP83867
	imply PHY_XILINX
	imply PHYS_64BIT
	imply PHY_GIGE
	imply DM_ETH
	imply DM_ETH_PHY
	imply XILINX_SPI
	imply MTD
	imply DM_MTD
	imply SPI
	imply SPI_FLASH
	imply SPI_FLASH_MTD
	imply SPI_FLASH_STMICRO
	imply SPI_FLASH_MACRONIX

endif
```

## configs/scr_rv64_l2_cluster_defconfig
```kconfig
#
# Copyright (C) 2024, Syntacore Ltd.
#
# This program is free software; you can redistribute it and/or
# modify it under the terms of the GNU General Public License
# as published by the Free Software Foundation; either version 2
# of the License, or (at your option) any later version.
#
# This program is distributed in the hope that it will be useful,
# but WITHOUT ANY WARRANTY; without even the implied warranty of
# MERCHANTABILITY or FITNESS FOR A PARTICULAR PURPOSE.  See the
# GNU General Public License for more details.
#
# You should have received a copy of the GNU General Public License
# along with this program; if not, write to the Free Software
# Foundation, Inc., 51 Franklin Street, Fifth Floor, Boston, MA 02110-1301, USA.
# Also add information on how to contact you by electronic and paper mail.

CONFIG_RISCV=y
CONFIG_TARGET_SCR_L2_CLUSTER=y
CONFIG_ARCH_RV64I=y
CONFIG_TEXT_BASE=0x400000
CONFIG_SYS_LOAD_ADDR=0x800000
CONFIG_SYS_BOOTM_LEN=0x10000000
CONFIG_SYS_MALLOC_LEN=0x800000
CONFIG_SYS_MALLOC_F_LEN=0x3000
CONFIG_HAS_CUSTOM_SYS_INIT_SP_ADDR=y
CONFIG_CUSTOM_SYS_INIT_SP_ADDR=0x400000
CONFIG_NR_DRAM_BANKS=1
CONFIG_CMODEL_MEDANY=y
CONFIG_RISCV_SMODE=y
CONFIG_SBI_V01=y
CONFIG_SMP=y
CONFIG_RESET_PHY_R=y
CONFIG_DISPLAY_CPUINFO=y
CONFIG_DISPLAY_BOARDINFO=y
CONFIG_DISPLAY_BOARDINFO_LATE=y
CONFIG_HUSH_PARSER=y
CONFIG_CMD_TFTPBOOT=y
CONFIG_CMD_MEMINFO=y
CONFIG_CMD_DHCP=y
CONFIG_CMD_PING=y
CONFIG_CMD_MII=y
CONFIG_CMD_SPI=y
CONFIG_CMD_MTD=y
CONFIG_EFI_LOADER=n
# CONFIG_REQUIRE_SERIAL_CONSOLE is not set
# CONFIG_AUTOBOOT is not set
```
